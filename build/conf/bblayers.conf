## build/conf/bblayers.conf
```bitbake
# POKY_BBLAYERS_CONF_VERSION is increased each time build/conf/bblayers.conf
# changes incompatibly
POKY_BBLAYERS_CONF_VERSION = "2"

BBPATH = "${TOPDIR}"
BBFILES ?= ""

BBLAYERS ?= " \
  /home/anon/Dev/Yocto2/poky/meta \
  /home/anon/Dev/Yocto2/poky/meta-poky \
  /home/anon/Dev/Yocto2/poky/meta-yocto-bsp \
  /home/anon/Dev/Yocto2/meta-raspberrypi \
  "
```
